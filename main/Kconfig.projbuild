## main/Kconfig.projbuild
```kconfig
menu "RTC & I2C Configuration"

    config SCL_GPIO
        int "SCL GPIO number"
        range 0 34
        default 15
        help
            GPIO number (IOxx) for I2C Clock.
            Some GPIOs are used for other purposes (flash connections, etc.) and cannot be used to CS.
            GPIOs 35-39 are input-only so cannot be used as outputs.

    config SDA_GPIO
        int "SDA GPIO number"
        range 0 34
        default 7
        help
            GPIO number (IOxx) to I2C SDA.
            Some GPIOs are used for other purposes (flash connections, etc.) and cannot be used to DC.
            GPIOs 35-39 are input-only so cannot be used as outputs.

    config TIMEZONE
        int "Your TimeZone"
        range -23 23
        default 2
        help
            Your local timezone.
            When it is 0, Greenwich Mean Time.

    choice MODE
        prompt "Access Mode"
        default SET_CLOCK
        help
            Select mode for the example.
        config SET_CLOCK
            bool "Set RTC Clock"
            help
                Set clock for RTC & Get clock from RTC.
        config GET_CLOCK
            bool "Only Get Clock"
            help
                Get clock from RTC.
        
    endchoice

    config NTP_SERVER
        string "NTP Server"
        default "pool.ntp.org"
        help
            Hostname for NTP Server.

endmenu
```
